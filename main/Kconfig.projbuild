## main/Kconfig.projbuild
```kconfig
menu "Robello Remo1"

menu "WiFi Settings"
config ESP_WIFI_SSID
    string "WiFi STA SSID"
    default ""
    help
    WiFi SSID (network name) to connect to or empty for Off.

config ESP_WIFI_PASSWORD
    string "WiFi STA Password"
    default ""
    help
    WiFi Password if WEP/WPA/WPA2 or empty if Open.
    
config ESP_MAXIMUM_RETRY
    int "Maximum retry"
    default 5
    help
    Set the Maximum retry to avoid station reconnecting to the AP unlimited when the AP is really inexistent.

config ESP_WIFI_AP_SSID
    string "WiFi AP SSID"
    default "RobelloRemo1"
    help
	AP SSID (network name) to create or empty for Off.

config ESP_WIFI_AP_PASSWORD
    string "WiFi AP Password"
    default "RobelloRemo1"
    help
	AP password for WPA2 or empty for Open.

config SERVER_IP
    string "WiFi AP IP Address"
    default "192.168.4.1"
    help
    IP address that the ESP will assign to it's AP interface. You can use this IP to connect to the Remo1 after flashing.

config LWIP_LOCAL_HOSTNAME
    string "Local hostname"
    default "RobelloRemo1"
    help
    The hostname under which the camera will be accessible in the local network.
endmenu

menu "Client Settings"
config CLIENT_DHCP
    bool "WiFi DHCP"
    default y
    help
    The client address will be assigned by DHCP or manually.

config CLIENT_GATEWAY
    depends on CLIENT_DHCP
    string "WiFi Gateway Address"
    default "192.168.0.1"
    help
    Gateway.
    
config CLIENT_IP
    depends on CLIENT_DHCP
    string "WiFi IP Address"
    default "192.168.0.33"
    help
    IP address that the ESP will assign to it's interface.
    
config CLIENT_NETMASK
    depends on CLIENT_DHCP
    string "WiFi Netmask"
    default "255.255.255.0"
    help
    Netmask.

config CLIENT_DNS1
    depends on CLIENT_DHCP
    string "WiFi DNS 1 Address"
    default "0.0.0.0"
    help
    DNS 1.
    
config CLIENT_DNS2
    depends on CLIENT_DHCP
    string "WiFi DNS 2 Address"
    default "0.0.0.0"
    help
    DNS 2.
endmenu

menu "General Settings"
config REMO1_LED_INTENSITY
    int "Led intensity"
    range 0 255
    default 60
    help
    Led intensity.
endmenu

menu "mDNS Settings"
    config MDNS_ENABLED
        bool "mDNS Enabled"
        default y
        help
            Should mDNS be used

    config MDNS_INSTANCE
        depends on MDNS_ENABLED
        string "mDNS Instance Name"
        default "Robello Remo1 Web Server"
        help
            mDNS Instance Name to use
endmenu

menu "SNTP Configuration"
    config SNTP_ENABLED
        bool "Enable SNTP Time Synchronization"
        default y
        help
            Enable SNTP Time Synchronization.

    config NTP_SERVER
        depends on SNTP_ENABLED
        string "NTP Server"
        default "pool.ntp.org"
        help
            Choose a default ntp server.

    config TIMEZONE
        depends on SNTP_ENABLED
        string "Timezone"
        default "1"
        help
            For help see: https://www.gnu.org/software/libc/manual/html_node/TZ-Variable.html           
endmenu

endmenu
```

## sdkconfig.defaults
```kconfig
CONFIG_ESPTOOLPY_PORT="/dev/ttyUSB1"
CONFIG_ESPTOOLPY_BAUD_115200B=
CONFIG_ESPTOOLPY_BAUD_230400B=
CONFIG_ESPTOOLPY_BAUD_921600B=y
CONFIG_ESPTOOLPY_BAUD_2MB=
CONFIG_ESPTOOLPY_BAUD_OTHER=
CONFIG_ESPTOOLPY_BAUD_OTHER_VAL=115200
CONFIG_ESPTOOLPY_BAUD=921600
CONFIG_ESPTOOLPY_COMPRESSED=y
CONFIG_FLASHMODE_QIO=y
CONFIG_FLASHMODE_QOUT=
CONFIG_FLASHMODE_DIO=
CONFIG_FLASHMODE_DOUT=
CONFIG_ESPTOOLPY_FLASHMODE="dio"
CONFIG_ESPTOOLPY_FLASHFREQ_80M=y
CONFIG_ESPTOOLPY_FLASHFREQ_40M=
CONFIG_ESPTOOLPY_FLASHFREQ_26M=
CONFIG_ESPTOOLPY_FLASHFREQ_20M=
CONFIG_ESPTOOLPY_FLASHFREQ="80m"
CONFIG_ESPTOOLPY_FLASHSIZE_1MB=
CONFIG_ESPTOOLPY_FLASHSIZE_2MB=
CONFIG_ESPTOOLPY_FLASHSIZE_4MB=y
CONFIG_ESPTOOLPY_FLASHSIZE_8MB=
CONFIG_ESPTOOLPY_FLASHSIZE_16MB=
CONFIG_ESPTOOLPY_FLASHSIZE="4MB"
CONFIG_ESPTOOLPY_FLASHSIZE_DETECT=y
CONFIG_ESPTOOLPY_BEFORE_RESET=y
CONFIG_ESPTOOLPY_BEFORE_NORESET=
CONFIG_ESPTOOLPY_BEFORE="default_reset"
CONFIG_ESPTOOLPY_AFTER_RESET=y
CONFIG_ESPTOOLPY_AFTER_NORESET=
CONFIG_ESPTOOLPY_AFTER="hard_reset"
CONFIG_MONITOR_BAUD_9600B=
CONFIG_MONITOR_BAUD_57600B=
CONFIG_MONITOR_BAUD_115200B=y
CONFIG_MONITOR_BAUD_230400B=
CONFIG_MONITOR_BAUD_921600B=
CONFIG_MONITOR_BAUD_2MB=
CONFIG_MONITOR_BAUD_OTHER=
CONFIG_MONITOR_BAUD_OTHER_VAL=115200
CONFIG_MONITOR_BAUD=115200

#
# Partition Table
#
CONFIG_PARTITION_TABLE_SINGLE_APP=
CONFIG_PARTITION_TABLE_TWO_OTA=y
CONFIG_PARTITION_TABLE_CUSTOM=
CONFIG_PARTITION_TABLE_CUSTOM_FILENAME=
CONFIG_PARTITION_TABLE_FILENAME=
CONFIG_PARTITION_TABLE_OFFSET=0x8000
CONFIG_PARTITION_TABLE_MD5=y

#
# ESP32-specific
#
CONFIG_ESP32_DEFAULT_CPU_FREQ_80=y
CONFIG_ESP32_DEFAULT_CPU_FREQ_160=
CONFIG_ESP32_DEFAULT_CPU_FREQ_240=
CONFIG_ESP32_DEFAULT_CPU_FREQ_MHZ=80
CONFIG_SPIRAM_SUPPORT=y

#
# SPI RAM config
#
CONFIG_SPIRAM_BOOT_INIT=n
CONFIG_SPIRAM_IGNORE_NOTFOUND=
CONFIG_SPIRAM_USE_MEMMAP=
CONFIG_SPIRAM_USE_CAPS_ALLOC=y
CONFIG_SPIRAM_USE_MALLOC=
CONFIG_SPIRAM_TYPE_AUTO=y
CONFIG_SPIRAM_TYPE_ESPPSRAM32=
CONFIG_SPIRAM_TYPE_ESPPSRAM64=
CONFIG_SPIRAM_SIZE=-1
CONFIG_SPIRAM_SPEED_40M=
CONFIG_SPIRAM_SPEED_80M=y
CONFIG_SPIRAM_MEMTEST=y
CONFIG_SPIRAM_CACHE_WORKAROUND=y
CONFIG_SPIRAM_BANKSWITCH_ENABLE=y
CONFIG_SPIRAM_BANKSWITCH_RESERVE=8
CONFIG_WIFI_LWIP_ALLOCATION_FROM_SPIRAM_FIRST=
CONFIG_SPIRAM_ALLOW_BSS_SEG_EXTERNAL_MEMORY=

CONFIG_TASK_WDT=

#
# MQTT Client configuration
#
CONFIG_MQTT_CLEAN_SESSION=
CONFIG_MQTT_AUTO_RECONNECT=
CONFIG_MQTT_PORT=1883
CONFIG_MQTT_LWT_QOS=1


# RTC IO SUPPORT
CONFIG_RTCIO_SUPPORT_RTC_GPIO_DESC=y

CONFIG_ESP_WIFI_SSID=""
CONFIG_ESP_WIFI_PASSWORD=""
CONFIG_ESP_MAXIMUM_RETRY=5
CONFIG_ESP_WIFI_AP_SSID="RobelloRemo1"
CONFIG_ESP_WIFI_AP_PASSWORD="RobelloRemo1"
CONFIG_SERVER_IP="192.168.4.1"
CONFIG_LWIP_LOCAL_HOSTNAME="RobelloRemo1"
CONFIG_CLIENT_DHCP=y
CONFIG_CLIENT_GATEWAY="192.168.0.1"
CONFIG_CLIENT_IP="192.168.0.33"
CONFIG_CLIENT_NETMASK="255.255.255.0"
CONFIG_CLIENT_DNS1="0.0.0.0"
CONFIG_CLIENT_DNS2="0.0.0.0"
CONFIG_REMO1_LED_INTENSITY=60
CONFIG_MDNS_ENABLED=y
CONFIG_MDNS_INSTANCE="RobelloRemo1"
CONFIG_SNTP_ENABLED=y
CONFIG_NTP_SERVER="pool.ntp.org"
CONFIG_TIMEZONE="1"
CONFIG_BT_ENABLED=y
CONFIG_BTDM_CTRL_MODE_BR_EDR_ONLY=y
CONFIG_BT_BLUEDROID_ENABLED=y
CONFIG_BTDM_CTRL_BR_EDR_MAX_ACL_CONN=3
CONFIG_BTDM_CTRL_PINNED_TO_CORE_0=y
CONFIG_BTDM_CTRL_PINNED_TO_CORE=0
CONFIG_BT_BLUEDROID_ENABLED=y
CONFIG_BT_BLUEDROID_PINNED_TO_CORE_0=y
CONFIG_BT_BLUEDROID_PINNED_TO_CORE=0
CONFIG_BT_CLASSIC_ENABLED=y
CONFIG_BT_SPP_ENABLED=y
CONFIG_BT_SSP_ENABLED=y
CONFIG_ESP32_WIFI_NVS_ENABLED=y
CONFIG_ESP32_WIFI_TASK_PINNED_TO_CORE_0=y
CONFIG_FATFS_CODEPAGE_850=y
CONFIG_FATFS_CODEPAGE=850
```
